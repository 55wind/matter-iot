## CMakeLists.txt
```
# SPDX-License-Identifier: Apache-2.0

cmake_minimum_required(VERSION 3.20.0)
find_package(Zephyr REQUIRED HINTS $ENV{ZEPHYR_BASE})
project(decision_node)

target_sources(app PRIVATE src/main.c src/decision.c)
```

## prj.conf
```kconfig
CONFIG_GPIO=y
CONFIG_SHELL=y
CONFIG_FPU=y
CONFIG_CBPRINTF_FP_SUPPORT=y
```

## boards/nrf54lm20dk_nrf54lm20a_cpuapp.overlay
```dts
/ {
    aliases {
        relay-fan = &relay_fan;
    };
    relays {
        compatible = "gpio-leds";
        relay_fan: relay_fan {
            gpios = <&gpio1 4 GPIO_ACTIVE_HIGH>;  /* 고른 핀으로 변경 (relay_test와 같은 핀) */
        };
    };
};
```

## boards/nrf54lm20dk_nrf54lm20b_cpuapp.overlay
```dts
/ {
    aliases {
        relay-fan = &relay_fan;
    };
    relays {
        compatible = "gpio-leds";
        relay_fan: relay_fan {
            gpios = <&gpio1 20 GPIO_ACTIVE_LOW>;  /* P1.20 → 릴레이 IN1, LOW에서 켜지는 릴레이 (IN2는 예비) */
        };
    };
};
```

## src/main.c
```c
#include <zephyr/kernel.h>
#include <zephyr/drivers/gpio.h>
#include "decision.h"

static const struct gpio_dt_spec humid_led = GPIO_DT_SPEC_GET(DT_ALIAS(led1), gpios);
static const struct gpio_dt_spec fan_led   = GPIO_DT_SPEC_GET(DT_ALIAS(led2), gpios);
static const struct gpio_dt_spec fan_relay = GPIO_DT_SPEC_GET(DT_ALIAS(relay_fan), gpios);

void outputs_apply(bool h, bool f)
{
    gpio_pin_set_dt(&humid_led, h);   /* LED1 = 가습기 */
    gpio_pin_set_dt(&fan_led, f);     /* LED2 = 선풍기 */
    gpio_pin_set_dt(&fan_relay, f);   /* 딸깍 */
}
void inputs_changed(void) {}

int main(void)
{
    gpio_pin_configure_dt(&humid_led, GPIO_OUTPUT_INACTIVE);
    gpio_pin_configure_dt(&fan_led, GPIO_OUTPUT_INACTIVE);
    gpio_pin_configure_dt(&fan_relay, GPIO_OUTPUT_INACTIVE);
    decision_start();
    return 0;
}
```

## src/decision.c
```c
#include <zephyr/kernel.h>
#include <zephyr/shell/shell.h>
#include <math.h>
#include <stdlib.h>
#include "decision.h"

struct inputs g_in = { 24.0f, 45.0f, 24.0f, 50.0f };
static bool humid_on = true, fan_on = false;
static int64_t last_change;
static int hold_ms = 10000;               /* 시연 10초, 실제 60초 */

#define ON_TH  75.0f
#define OFF_TH 70.0f

static float psat(float t) { return 6.112f * expf(17.62f * t / (243.12f + t)); }
float surface_rh(void) { return g_in.room_rh * psat(g_in.room_t) / psat(g_in.wall_t); }

static void set_state(bool h, bool f, const char *why)
{
    if (h && f) return;                   /* 동시 가동 금지 */
    humid_on = h; fan_on = f;
    last_change = k_uptime_get();
    outputs_apply(humid_on, fan_on);
    printk("EVT humid=%d fan=%d srh=%.1f why=%s\n", h, f, (double)surface_rh(), why);
}

static void tick(struct k_work *w);
static K_WORK_DELAYABLE_DEFINE(tick_work, tick);

static void tick(struct k_work *w)
{
    float s = surface_rh();
    bool held = (k_uptime_get() - last_change) >= hold_ms;

    if (s >= ON_TH && humid_on) {
        set_state(false, false, "srh>=75 humid_off");
    } else if (s >= ON_TH && !fan_on) {
        set_state(false, true, "srh>=75 fan_on");       /* 0.5초 뒤 */
    } else if (s < OFF_TH && fan_on && held) {
        set_state(false, false, "srh<70 fan_off_first");
    } else if (s < OFF_TH && !fan_on && !humid_on && held) {
        set_state(true, false, "srh<70 stable humid_on");
    }
    printk("VAL srh=%.1f humid=%d fan=%d\n", (double)s, humid_on, fan_on);
    k_work_schedule(&tick_work, K_MSEC(500));
}

void decision_start(void)
{
    set_state(true, false, "boot");
    k_work_schedule(&tick_work, K_NO_WAIT);
}

static int cmd_sim(const struct shell *sh, size_t argc, char **argv)
{
    g_in.room_t  = strtof(argv[1], NULL);
    g_in.room_rh = strtof(argv[2], NULL);
    g_in.wall_t  = strtof(argv[3], NULL);
    g_in.bed_rh  = strtof(argv[4], NULL);
    inputs_changed();
    return 0;
}
SHELL_CMD_ARG_REGISTER(sim, NULL, "sim <room_t> <room_rh> <wall_t> <bed_rh>", cmd_sim, 5, 0);

static int cmd_hold(const struct shell *sh, size_t argc, char **argv)
{
    hold_ms = atoi(argv[1]) * 1000;
    shell_print(sh, "hold=%d s", hold_ms / 1000);
    return 0;
}
SHELL_CMD_ARG_REGISTER(hold, NULL, "hold <sec>", cmd_hold, 2, 0);
```

## src/decision.h
```c
#pragma once
#include <stdbool.h>
#ifdef __cplusplus
extern "C" {
#endif
struct inputs { float room_t, room_rh, wall_t, bed_rh; };
extern struct inputs g_in;
float surface_rh(void);
void decision_start(void);
void outputs_apply(bool humid, bool fan);  /* 5단계: GPIO, 6단계: Matter */
void inputs_changed(void);                 /* 5단계: 빈 함수, 6단계: 센서 속성 갱신 */
#ifdef __cplusplus
}
#endif
```
