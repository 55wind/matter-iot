/ {
    aliases {
        led0 = &relay_fan;
    };
    relays {
        compatible = "gpio-leds";
        relay_fan: relay_fan {
            gpios = <&gpio1 20 GPIO_ACTIVE_LOW>;  /* P1.20 → 릴레이 IN1, LOW에서 켜지는 릴레이 (IN2는 예비) */
        };
    };
};
