/ {
    aliases {
        led0 = &relay_fan;
    };
    relays {
        compatible = "gpio-leds";
        relay_fan: relay_fan {
            gpios = <&gpio1 4 GPIO_ACTIVE_HIGH>;  /* 고른 핀으로 변경 (P1.04 → &gpio1 4) */
        };
    };
};
